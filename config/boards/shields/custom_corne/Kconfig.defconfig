## config/boards/shields/custom_corne/Kconfig.defconfig
```kconfig
if SHIELD_CUSTOM_CORNE_LEFT || SHIELD_CUSTOM_CORNE_RIGHT

config ZMK_KEYBOARD_NAME
    default "Custom Corne"

config ZMK_SPLIT
    default y

if SHIELD_CUSTOM_CORNE_LEFT
config ZMK_SPLIT_ROLE_CENTRAL
    default y
endif

endif
```

## config/boards/shields/custom_corne/Kconfig.shield
```kconfig
config SHIELD_CUSTOM_CORNE_LEFT
    def_bool $(shields_list_contains,custom_corne_left)

config SHIELD_CUSTOM_CORNE_RIGHT
    def_bool $(shields_list_contains,custom_corne_right)
```
